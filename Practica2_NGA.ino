#include "time.h"
#include <SPI.h>
#include <Wire.h>
#include <Adafruit_GFX.h>
#include <Adafruit_SSD1306.h>
#include "DFRobot_SHT20.h"
#include <WiFiClient.h>
#include <BlynkSimpleEsp32.h>
#include <stdio.h>

#define SCREEN_WIDTH 128  // OLED display width, in pixels
#define SCREEN_HEIGHT 32  // OLED display height, in pixels
#define BLYNK_TEMPLATE_ID "TMPL2407ygy12"
#define BLYNK_TEMPLATE_NAME "Quickstart Template"
#define BLYNK_AUTH_TOKEN "fBc7lM8ZSGqXLF1bVKGjgSMf9gRC4vAq"

/* Comment this out to disable prints and save space */
#define BLYNK_PRINT Serial


// Your WiFi credentials.
// Set password to "" for open networks.
char ssid[] = "Tenda-2C5010";
char pass[] = "area8778";

BlynkTimer timer;

//Declaraciones para la fecha
const char* ntpServer = "pool.ntp.org";
const long  gmtOffset_sec = -21600;
const int   daylightOffset_sec = 0;

// Declaration for an SSD1306 display connected to I2C (SDA, SCL pins)
// The pins for I2C are defined by the Wire-library.
// On an arduino UNO:       A4(SDA), A5(SCL)
// On an arduino MEGA 2560: 20(SDA), 21(SCL)
// On an arduino LEONARDO:   2(SDA),  3(SCL), ...
#define OLED_RESET -1        // Reset pin # (or -1 if sharing Arduino reset pin)
#define SCREEN_ADDRESS 0x3C  ///< See datasheet for Address; 0x3D for 128x64, 0x3C for 128x32
#define NUMFLAKES 10         // Number of snowflakes in the animation example
#define LOGO_HEIGHT 128
#define LOGO_WIDTH 32

//Logo inicial
#define NUMFLAKES 10  // Number of snowflakes in the animation example

//Se definen los datos de BME
#define BME_SCK 13
#define BME_MISO 12
#define BME_MOSI 11
#define BME_CS 10
#define SEALEVELPRESSURE_HPA (1013.25)

//Adafruit_BME680 bme;  // I2C
DFRobot_SHT20 sht20;

Adafruit_SSD1306 display(SCREEN_WIDTH, SCREEN_HEIGHT, &Wire, OLED_RESET);



static const unsigned char PROGMEM logo_bmp[] = { 0x00, 0x00, 0x00, 0x0e, 0xe0, 0x00, 0x0e, 0xec, 0x00, 0x0e, 0xde, 0x00, 0x06, 0xde, 0x00, 0x06,
                                                  0xdf, 0x00, 0x06, 0xcf, 0x00, 0x1c, 0xef, 0x00, 0x3b, 0xf7, 0x00, 0x37, 0xe7, 0x00, 0x37, 0xee,
                                                  0x00, 0x37, 0xde, 0x00, 0x1b, 0xdc, 0x00, 0x0c, 0x48, 0x00, 0x07, 0x6c, 0x00, 0x03, 0x76, 0x00,
                                                  0x07, 0x76, 0x00, 0x07, 0x73, 0x00, 0x07, 0x7b, 0x80, 0x0f, 0x7d, 0xc0, 0x00, 0x00, 0x00, 0x12,
                                                  0x97, 0x40, 0x22, 0xa4, 0x40, 0x22, 0xa4, 0x40, 0x22, 0x84, 0x40, 0x22, 0xa4, 0x40, 0x22, 0xa7,
                                                  0x40, 0x13, 0x93, 0x40, 0x00, 0x00, 0x00, 0x00, 0x00, 0x00, 0x00, 0x00, 0x00, 0x00, 0x00, 0x00 };



static const unsigned char PROGMEM foto[] = {
  0x00, 0x00, 0x00, 0x00, 0x00, 0x00, 0x00, 0x03, 0xc0, 0x00, 0x00, 0x00, 0x00, 0x00, 0x00, 0x00,
  0x00, 0x00, 0x00, 0x00, 0x00, 0x00, 0x00, 0x0f, 0xe0, 0x00, 0x00, 0x00, 0x00, 0x00, 0x00, 0x00,
  0x00, 0x00, 0x00, 0x00, 0x00, 0x00, 0x00, 0x1c, 0x70, 0x00, 0x00, 0x00, 0x00, 0x00, 0x00, 0x00,
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  0x00, 0x00, 0x00, 0x00, 0x00, 0x00, 0x00, 0x0f, 0xe0, 0x00, 0x00, 0x00, 0x00, 0x00, 0x00, 0x00
};

static const unsigned char PROGMEM gota_alto[] = {
  0x00, 0x01, 0x80, 0x00, 0x00, 0x00, 0x00, 0x00, 0x00, 0x00, 0x00, 0x00, 0x00, 0x00, 0x00, 0x00,
  0x00, 0x03, 0xc0, 0x00, 0x00, 0x00, 0x00, 0x00, 0x00, 0x00, 0x00, 0x00, 0x00, 0x00, 0x00, 0x00,
  0x00, 0x03, 0xc0, 0x00, 0x00, 0x00, 0x00, 0x00, 0x00, 0x00, 0x00, 0x00, 0x00, 0x00, 0x00, 0x00,
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  0x00, 0x07, 0xe0, 0x00, 0x00, 0x00, 0x00, 0x00, 0x00, 0x00, 0x00, 0x00, 0x00, 0x00, 0x00, 0x00
};

static const unsigned char PROGMEM gota_bajo[] = {
  0x00, 0x01, 0x80, 0x00, 0x00, 0x00, 0x00, 0x00, 0x00, 0x00, 0x00, 0x00, 0x00, 0x00, 0x00, 0x00,
  0x00, 0x03, 0xc0, 0x00, 0x00, 0x00, 0x00, 0x00, 0x00, 0x00, 0x00, 0x00, 0x00, 0x00, 0x00, 0x00,
  0x00, 0x03, 0xc0, 0x00, 0x00, 0x00, 0x00, 0x00, 0x00, 0x00, 0x00, 0x00, 0x00, 0x00, 0x00, 0x00,
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  0x00, 0x07, 0xe0, 0x00, 0x00, 0x00, 0x00, 0x00, 0x00, 0x00, 0x00, 0x00, 0x00, 0x00, 0x00, 0x00
};

static const unsigned char PROGMEM gota_medio[] = {
  0x00, 0x01, 0x80, 0x00, 0x00, 0x00, 0x00, 0x00, 0x00, 0x00, 0x00, 0x00, 0x00, 0x00, 0x00, 0x00,
  0x00, 0x03, 0xc0, 0x00, 0x00, 0x00, 0x00, 0x00, 0x00, 0x00, 0x00, 0x00, 0x00, 0x00, 0x00, 0x00,
  0x00, 0x03, 0xc0, 0x00, 0x00, 0x00, 0x00, 0x00, 0x00, 0x00, 0x00, 0x00, 0x00, 0x00, 0x00, 0x00,
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  0x00, 0x07, 0xe0, 0x00, 0x00, 0x00, 0x00, 0x00, 0x00, 0x00, 0x00, 0x00, 0x00, 0x00, 0x00, 0x00
};

static const unsigned char PROGMEM termometro_bajo[] = {
  0x00, 0x00, 0x00, 0x00, 0x00, 0x00, 0x00, 0x00, 0x00, 0x00, 0x00, 0x00, 0x00, 0x00, 0x00, 0x00,
  0x00, 0x07, 0xe0, 0x00, 0x00, 0x00, 0x00, 0x00, 0x00, 0x00, 0x00, 0x00, 0x00, 0x00, 0x00, 0x00,
  0x00, 0x0c, 0x30, 0x00, 0x00, 0x00, 0x00, 0x00, 0x00, 0x00, 0x00, 0x00, 0x00, 0x00, 0x00, 0x00,
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  0x00, 0x00, 0x00, 0x00, 0x00, 0x00, 0x00, 0x00, 0x00, 0x00, 0x00, 0x00, 0x00, 0x00, 0x00, 0x00
};



static const unsigned char PROGMEM termometro_medio[] = {
  0x00, 0x00, 0x00, 0x00, 0x00, 0x00, 0x00, 0x00, 0x00, 0x00, 0x00, 0x00, 0x00, 0x00, 0x00, 0x00,
  0x00, 0x07, 0xe0, 0x00, 0x00, 0x00, 0x00, 0x00, 0x00, 0x00, 0x00, 0x00, 0x00, 0x00, 0x00, 0x00,
  0x00, 0x0c, 0x30, 0x00, 0x00, 0x00, 0x00, 0x00, 0x00, 0x00, 0x00, 0x00, 0x00, 0x00, 0x00, 0x00,
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  0x00, 0x00, 0x00, 0x00, 0x00, 0x00, 0x00, 0x00, 0x00, 0x00, 0x00, 0x00, 0x00, 0x00, 0x00, 0x00
};

static const unsigned char PROGMEM termometro_alto[] = {
  0x00, 0x00, 0x00, 0x00, 0x00, 0x00, 0x00, 0x00, 0x00, 0x00, 0x00, 0x00, 0x00, 0x00, 0x00, 0x00,
  0x00, 0x07, 0xe0, 0x00, 0x00, 0x00, 0x00, 0x00, 0x00, 0x00, 0x00, 0x00, 0x00, 0x00, 0x00, 0x00,
  0x00, 0x0c, 0x30, 0x00, 0x00, 0x00, 0x00, 0x00, 0x00, 0x00, 0x00, 0x00, 0x00, 0x00, 0x00, 0x00,
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  0x00, 0x00, 0x00, 0x00, 0x00, 0x00, 0x00, 0x00, 0x00, 0x00, 0x00, 0x00, 0x00, 0x00, 0x00, 0x00
};

static int contadorSegundos = 0;

void cambiarContadorSegundos() {
  if (contadorSegundos != 9) {
    contadorSegundos++;
  } else {
    contadorSegundos = 0;
  }
}

void printLocalTime() {
  struct tm timeinfo;
  if(!getLocalTime(&timeinfo)){
    Serial.println("Failed to obtain time");
    return;
  }
  tm->dat
  Serial.println(&timeinfo, "%A, %B %d %Y %H:%M:%S");
}

#define XPOS 0  // Indexes into the 'icons' array in function below
#define YPOS 1
#define DELTAY 2
void testanimate(const uint8_t *bitmap, uint8_t w, uint8_t h) {
  int8_t f, icons[NUMFLAKES][3];

  // Initialize 'snowflake' positions
  for (f = 0; f < NUMFLAKES; f++) {

    icons[f][XPOS] = random(1 - LOGO_WIDTH, display.width());
    icons[f][YPOS] = -LOGO_HEIGHT;
    icons[f][DELTAY] = random(1, 6);
    Serial.print(F("x: "));
    Serial.print(icons[f][XPOS], DEC);
    Serial.print(F(" y: "));
    Serial.print(icons[f][YPOS], DEC);
    Serial.print(F(" dy: "));
    Serial.println(icons[f][DELTAY], DEC);
  }

  for (int i = 0; i < 10; i++) {  // Loop forever...
    display.clearDisplay();       // Clear the display buffer

    // Draw each snowflake:
    for (f = 0; f < NUMFLAKES; f++) {
      display.drawBitmap(icons[f][XPOS], icons[f][YPOS], bitmap, w, h, SSD1306_WHITE);
    }

    display.display();  // Show the display buffer on the screen
    delay(200);         // Pause for 1/10 second

    // Then update coordinates of each flake...
    for (f = 0; f < NUMFLAKES; f++) {
      icons[f][YPOS] += icons[f][DELTAY];
      // If snowflake is off the bottom of the screen...
      if (icons[f][YPOS] >= display.height()) {
        // Reinitialize to a random position, just off the top
        icons[f][XPOS] = random(1 - LOGO_WIDTH, display.width());
        icons[f][YPOS] = -LOGO_HEIGHT;
        icons[f][DELTAY] = random(1, 6);
      }
    }
  }
}

void dibujarLineaTiempo() {
  int tiempo, valor;
  int arregloAncho[] = { 127, 102, 76, 51, 25 };
  tiempo = contadorSegundos;
  if (tiempo >= 5) {
    tiempo = tiempo - 5;
  }
  switch (tiempo) {
    case 0:
      display.drawRect(0, 30, 127, 2, WHITE);
      break;
    case 1:
      display.drawRect(0, 30, 95, 2, WHITE);
      break;
    case 2:
      display.drawRect(0, 30, 63, 2, WHITE);
      break;
    case 3:
      display.drawRect(0, 30, 31, 2, WHITE);
      break;
    case 4:
      display.drawRect(0, 30, 0, 2, WHITE);
      break;
  }
}

void setup() {
  Serial.begin(115200);
  Blynk.begin(BLYNK_AUTH_TOKEN, ssid, pass);
  if (!display.begin(SSD1306_SWITCHCAPVCC, 0x3C)) {
    Serial.println(F("SSD1306 allocation failed"));
    for (;;);
  }

  sht20.initSHT20(); // Init SHT20 Sensor
  delay(100);
  sht20.checkSHT20();

  configTime(gmtOffset_sec, daylightOffset_sec, ntpServer);

  testanimate(logo_bmp, LOGO_WIDTH, LOGO_HEIGHT);  // Animate bitmaps
  display.display();
  delay(2000);  // Pause for 2 seconds
}

void loop() {
  Blynk.run();
  timer.run();

  //Número de control
  int numeroControl = random(0, 3);

  //Cadenas
  char cadenaTemperatura[8];  //°C
  char cadenaHumedad[5];      //%

  //Valores del sensor
  int temperatura = (int) sht20.readTemperature();
  int humedad = (int) sht20.readHumidity();

  //Se generan las cadenas con el valor y el símbolo
  snprintf(cadenaTemperatura, 8, "%d  C", temperatura);
  snprintf(cadenaHumedad, 5, "%d%%", humedad);

  display.setTextColor(SSD1306_WHITE);


  if (contadorSegundos < 5) {
    display.clearDisplay();
    //Se muestra la temperatura y la humedad

    if (numeroControl == 0) {
      display.drawBitmap(0, 0, gota_bajo, SCREEN_WIDTH, SCREEN_HEIGHT, 1);
      display.drawBitmap(64, 0, termometro_bajo, SCREEN_WIDTH, SCREEN_HEIGHT, 1);
    } else if (numeroControl == 1) {
      display.drawBitmap(0, 0, gota_medio, SCREEN_WIDTH, SCREEN_HEIGHT, 1);
      display.drawBitmap(64, 0, termometro_medio, SCREEN_WIDTH, SCREEN_HEIGHT, 1);
    } else {
      display.drawBitmap(0, 0, gota_alto, SCREEN_WIDTH, SCREEN_HEIGHT, 1);
      display.drawBitmap(64, 0, termometro_alto, SCREEN_WIDTH, SCREEN_HEIGHT, 1);
    }
    //display.setTextSize(1);
    //Se imprime la humedad
    display.setCursor(31, 10);
    display.println("Humedad");
    display.setCursor(40, 19);
    display.println(cadenaHumedad);
    //Se imprime la temperatura
    display.setCursor(92, 10);
    display.print("Temp.");
    display.setCursor(95, 19);
    display.print(cadenaTemperatura);
    display.drawCircle(114, 21, 2, WHITE);

  } else if (contadorSegundos >= 4) {
    display.clearDisplay();
    printLocalTime();
  }

  Blynk.virtualWrite(V0, temperatura);
  Blynk.virtualWrite(V2, humedad);


  dibujarLineaTiempo();

  display.display();
  delay(1000);
  cambiarContadorSegundos();
}